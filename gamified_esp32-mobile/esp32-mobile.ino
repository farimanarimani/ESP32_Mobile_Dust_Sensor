/*

   ==general==
   This script uses the non-volatile storage of esp32 to store key value pairs. These can be accessed via BLE-connection (read and/or write).

   ==BLE==
   BLE part Based on Neil Kolban example for IDF: https://github.com/nkolban/esp32-snippets/blob/master/cpp_utils/tests/BLE%20Tests/SampleWrite.cpp
   Ported to Arduino ESP32 by Evandro Copercini
   edited by ernst (ernst@teco.edu)

   ==NVS==
   ESP32 key value store with Preferences library.
   uses the Preferences library to store key value pairs in
   non-volatile storage on ESP32 processor.
   created for arduino-esp32 09 Jul 2018
   by Felix Ernst (ernst(at)teco.edu)

   namespace limited to 15 chars
   key name limited to 15 chars

   ==WATCHDOG==
   the BLE stack is not stable and stops advertising after a random time between some minutes and some hours
   the watchdog reboots the ESP if no device reads the sensor values (PM10 values)

   last edits:
   02.09.18 by Felix Ernst (ernst@teco.edu)
*/
#include "src/lib/ArduinoJson/ArduinoJson.h"
#include <BLE2902.h>
#include <sstream> //c++ libary to use std::string
#include <sdkconfig.h>
#include <BLEDevice.h>
#include <BLEUtils.h>
#include <BLEServer.h>
#include <BLEDescriptor.h>
#include <Preferences.h>
#include "Arduino.h"
#include "bleobjects.h"
#include "nvscallback.h"
#include "sensor.h"
#include "watchdog.h"
#include "datadescription.h"
#include "connectCallback.h"
#include<U8g2lib.h>

// this will assign the name PushButton to pin numer 21
const int PushButton = 21;

U8G2_SSD1306_128X64_NONAME_F_SW_I2C u8g2(U8G2_R0, /* clock=*/ 15, /* data=*/ 4, /* reset=*/ 16);


#define duster1_width 92
#define duster1_height 64
static const unsigned char duster1_bits[] PROGMEM = {
  0x00, 0x00, 0x00, 0x00, 0x00, 0x00, 0x00, 0x00, 0x00, 0x00, 0x00, 0x00,
  0x00, 0x00, 0x00, 0x00, 0x00, 0x00, 0x00, 0xD0, 0xFF, 0x01, 0x00, 0x00,
  0x00, 0x00, 0x00, 0x00, 0x00, 0x00, 0x00, 0xF8, 0xFF, 0x03, 0x00, 0x00,
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  0x00, 0x00, 0x00, 0x00, 0x00, 0x00, 0x00, 0x40, 0x5F, 0x00, 0x00, 0x00,
};

#define duster2_width 93
#define duster2_height 64
static const unsigned char duster2_bits[] PROGMEM = {
  0x00, 0x00, 0x00, 0x00, 0x00, 0x00, 0x00, 0x00, 0x00, 0x00, 0x00, 0x00,
  0x00, 0x00, 0x00, 0x00, 0x00, 0x00, 0x00, 0xC0, 0xFF, 0x05, 0x00, 0x00,
  0x00, 0x00, 0x00, 0x00, 0x00, 0x00, 0x00, 0xE0, 0xFF, 0x0F, 0x00, 0x00,
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  0x00, 0x00, 0x00, 0x00, 0x00, 0x00, 0x00, 0x00, 0x5D, 0x01, 0x00, 0x00,
};

#define sad_width 127
#define sad_height 35
static const unsigned char sad_bits[] PROGMEM = {
  0x00, 0x00, 0x00, 0x00, 0x00, 0x00, 0xE0, 0xFF, 0xFF, 0x1F, 0x00, 0x00,
  0x00, 0x00, 0x00, 0x00, 0x00, 0x00, 0x00, 0x00, 0x00, 0xF0, 0xFF, 0xFF,
  0xFF, 0xFF, 0x7F, 0x00, 0x00, 0x00, 0x00, 0x00, 0x00, 0x00, 0x00, 0x00,
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  0x00, 0x00, 0x00, 0x00, 0x00, 0x3E, 0x00, 0x00,
};


#define happy_width 127
#define happy_height 39
static const unsigned char happy_bits[] PROGMEM = {
  0x00, 0x00, 0x00, 0x00, 0x00, 0x00, 0x00, 0x00, 0x00, 0x00, 0x00, 0x00,
  0x00, 0x06, 0x00, 0x00, 0x00, 0x00, 0x70, 0x00, 0x00, 0x00, 0x00, 0x00,
  0x00, 0x00, 0x00, 0x00, 0x00, 0x07, 0x00, 0x00, 0x00, 0x00, 0xF0, 0x01,
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  0x00, 0x00, 0x80, 0xFF, 0xFF, 0x0F, 0x00, 0x00, 0x00, 0x00, 0x00, 0x00,
};


void draw_duster(uint8_t bleOn) {

  if (bleOn) {
    u8g2.setFont(u8g2_font_5x7_tf);
    u8g2.setFontRefHeightExtendedText();
    u8g2.setFontPosTop();
    //u8g2.setFontDirection(1);
    //u8g2.drawStr(120, 8, "CONNECTED!");
    //u8g2.drawXBMP(10, 0, duster1_width, duster1_height, duster1_bits);
    u8g2.drawXBMP(0, 10, happy_width, happy_height, happy_bits);


  } else {

    u8g2.setFont(u8g2_font_5x7_tf);
    u8g2.setFontRefHeightExtendedText();
    u8g2.setFontPosTop();
    //u8g2.setFontDirection(1);
    // u8g2.drawStr(120, 0, "NOT CONNECTED!");
    //u8g2.drawXBMP(10, 0, duster2_width, duster2_height, duster2_bits);
    u8g2.drawXBMP(0, 10, sad_width, sad_height, sad_bits);
  }

}


/*
   Setup part
*/

void setup() {
  // This statement will declare pin 21 as digital input
  pinMode(PushButton, INPUT);

  // Display
  u8g2.begin();
  u8g2.firstPage();
  do {
    draw_duster(0);
  } while ( u8g2.nextPage() );

  // make serial monitor printing available
  Serial.begin(115200);

  /*
     BLE
  */

  // initialise with name of ble device
  BLEDevice::init(DEVICE_NAME);
  //initialise bleServer
  pServer = BLEDevice::createServer();
  pServer->setCallbacks(new MyServerCallbacks());

  // initialise bleService
  pDustService = pServer->createService(DUST_SERVICE_UUID);
  pMetadataService = pServer->createService(METADATA_SERVICE_UUID);

  // initialise bleCharacteristic for config
  pMetadataCharacteristic = pMetadataService->createCharacteristic(
                              METADATA_CHARACTERISTIC_UUID,
                              // set the properties, only read possible too
                              BLECharacteristic::PROPERTY_READ |
                              BLECharacteristic::PROPERTY_WRITE
                            );
  // initialise bleButtonCharacteristic for sds011 sensor
  pButtonCharacteristic = pDustService->createCharacteristic(
                          BUTTINNOTIFY_CHARACTERISTIC_UUID,
                          // set the properties, only read possible too
                          BLECharacteristic::PROPERTY_READ |
                          BLECharacteristic::PROPERTY_NOTIFY
                        );

  // initialise bleCharacteristic for sds011 sensor
  pDataCharacteristic = pDustService->createCharacteristic(
                          DATA_CHARACTERISTIC_UUID,
                          // set the properties, only read possible too
                          BLECharacteristic::PROPERTY_READ
                        );

  // initialise bleCharacteristic for sds011 sensor
  pDataDescriptionCharacteristic = pDustService->createCharacteristic(
                                     DATADESCRIPTION_CHARACTERISTIC_UUID,
                                     // set the properties, only read possible too
                                     BLECharacteristic::PROPERTY_READ
                                   );

  // initialise bleCharacteristic for watchdog
  pNotifyCharacteristic = pDustService->createCharacteristic(
                            NOTIFY_CHARACTERISTIC_UUID,
                            // set the properties, only read possible too
                            BLECharacteristic::PROPERTY_READ |
                            BLECharacteristic::PROPERTY_NOTIFY |
                            BLECharacteristic::PROPERTY_INDICATE
                          );

  pNotifyDescriptor2902 = new BLE2902();
  pNotifyCharacteristic->addDescriptor(pNotifyDescriptor2902);



  // create JSON for descriptor which contains sensor meta data like units etc
  // default values, TODO: change that it checks if there is a value, if not use default value



  // create Json buffer. inside brackets: size of the pool in bytes.
  // Use arduinojson.org/assistant to compute the capacity.
  StaticJsonBuffer<1024> jsonBuffer_desc; //TODO set a good buffer size
  // create json root object
  JsonObject& description_json = jsonBuffer_desc.createObject();
  // create nested objects inside root object
  JsonObject& pm10_desc = description_json.createNestedObject("PM10");
  JsonObject& pm25_desc = description_json.createNestedObject("PM25");
  JsonObject& temp_desc = description_json.createNestedObject("TEMP");
  JsonObject& hum_desc = description_json.createNestedObject("HUM");
  JsonObject& atm_desc = description_json.createNestedObject("ATM");
  // add values to nested objects
  pm10_desc["UNIT"] = pm10_unit;
  pm25_desc["UNIT"] = pm25_unit;
  temp_desc["UNIT"] = temp_unit;
  hum_desc["UNIT"] = hum_unit;
  atm_desc["UNIT"] = atm_unit;
  pm10_desc["NAME"] = pm10_name;
  pm25_desc["NAME"] = pm25_name;
  temp_desc["NAME"] = temp_name;
  hum_desc["NAME"] = hum_name;
  atm_desc["NAME"] = atm_name;

  char description_json_char[512]; //TODO set maximum size of char here
  // create a char out of the json object
  description_json.printTo(description_json_char);

  pDataDescriptionCharacteristic->setValue(description_json_char);

  // Serial.println(description_json_char);

  // initialize characteristics
  pDataCharacteristic->setValue(String(-1).c_str());
  // notify characteristic notifies random values, just used to trigger reading in android app
  pNotifyCharacteristic->setValue("0");

  //callback to do something when a value is written or read
  //TODO ensure that key is not longer than 14
  const char* configkey = "config";
  nvsCallback *pMetadataCallback = new nvsCallback(configkey);
  pMetadataCharacteristic->setCallbacks(pMetadataCallback);
  watchdogCallback *pwatchdogCallback = new watchdogCallback();
  pDataCharacteristic->setCallbacks(pwatchdogCallback);

  pDustService->start();
  pMetadataService->start();

  // start advertising, so the device can be found
  pAdvertising = pServer->getAdvertising();
  pAdvertising->start();

  //SDS_SERIAL.begin(9600);
  sds.begin(&SDS_SERIAL, 12, 17);  // initialize SDS011 sensor


  /*
     watchdog setup
     hardware timer is set, if timer runs out, reboot is triggered
  */
  if (enable_wd == true) {
    timer = timerBegin(0, 80, true);                  //timer 0, div 80, initialise hardware timer
    timerAttachInterrupt(timer, &resetModule, true);  //attach callback
    timerAlarmWrite(timer, wdtTimeout * 1000, false); //set time in us
    timerAlarmEnable(timer);

  }
}



void loop() {


  if (!deviceConnected) {
    u8g2.firstPage();
    do {
      draw_duster(0);
    } while ( u8g2.nextPage() );
    Serial.println("Not Connectet");
    delay(100);
  } else {
    u8g2.firstPage();
    do {
      draw_duster(1);
    } while ( u8g2.nextPage() );
    //Serial.print("Connected");

    // digitalRead function stores the Push button state in variable push_button_state
    int Push_button_state = digitalRead(PushButton);
    //delay(10);
    if ( Push_button_state == HIGH ) {
      pButtonCharacteristic->setValue("down");
      Serial.print("Button");

      pNotifyCharacteristic->notify();

    } else {
      pButtonCharacteristic->setValue("up");

      int sdsError = sdsRead();
      if (!sdsError) {

        // default values, TODO: change that it checks if there is a value, if not use default value
        float temp = -1000;
        float hum = -1;
        float atm = -1;

        // create Json buffer. inside brackets: size of the pool in bytes.
        // Use arduinojson.org/assistant to compute the capacity.
        StaticJsonBuffer<1024> jsonBuffer; //TODO set a good buffer size
        // create json object
        JsonObject& data_values = jsonBuffer.createObject();
        // add all key-value pairs to json object
        data_values["PM10"] = pm10;
        data_values["PM25"] = pm25;
        data_values["TEMP"] = temp;
        data_values["HUM"] = hum;
        data_values["ATM"] = atm;

        char data_values_char[512]; //TODO set maximum size of char here
        // create a char out of the json object
        data_values.printTo(data_values_char);
        Serial.println(data_values_char);
        pDataCharacteristic->setValue(data_values_char);

        // notify characteristic changes value between "0" and "1", only to trigger reading in android app
        if (pNotifyCharacteristic->getValue() == "0") {
          pNotifyCharacteristic->setValue("1");
        }
        else {
          pNotifyCharacteristic->setValue("0");
        }
        pNotifyCharacteristic->notify();
      }
      //delay(10); // 100ms => f = 10/s
    }
  }

}
